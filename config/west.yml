## config/west.yml
```yaml
manifest:
  remotes:
    - name: urob
      url-base: https://github.com/urob
    - name: zmkfirmware
      url-base: https://github.com/zmkfirmware
    - name: carrefinho
      url-base: https://github.com/carrefinho

  projects:
    - name: zmk
      revision: main
      remote: zmkfirmware
      import: app/west.yml

    # ZMK modules
    - name: zmk-helpers
      remote: urob
      revision: main
    - name: zmk-auto-layer
      remote: urob
      revision: main

    # Prospector dongle
    - name: prospector-zmk-module
      remote: carrefinho
      revision: main

  self:
    path: config
```
