ZMK_LAYER(base_layer,
     //               ╭─────────────┬─────────────┬─────────────┬─────────────┬─────────────╮   ╭─────────────┬─────────────┬─────────────┬─────────────┬─────────────╮
                        &kp Q         &kp W         &kp E         &kp R         &kp T             &kp Y         &kp U         &kp I         &kp O         &kp P
     //               ├─────────────┼─────────────┼─────────────┼─────────────┼─────────────┤   ├─────────────┼─────────────┼─────────────┼─────────────┼─────────────┤
                        &hml LCTRL A  &hml LALT S   &hml LGUI D   &hml LSHIFT F HPR_G             HPR_H         &hmr RSHIFT J &hmr RGUI K   &hmr RALT L   &slash_morph 
     // ╭─────────────┼─────────────┼─────────────┼─────────────┼─────────────┼─────────────┤   ├─────────────┼─────────────┼─────────────┼─────────────┼─────────────┼─────────────╮
          &kp GRAVE     &kp Z         &kp X         &kp C         &kp V         &kp B             &kp N         &kp M         &comma_morph  &dot_morph    &excl         &kp SQT
     // ╰─────────────┴─────────────┴─────────────┼─────────────┼─────────────┼─────────────┤   ├─────────────┼─────────────┼─────────────┼─────────────┴─────────────┴─────────────╯
                                                    &kp ESC       NAV_SPACE     SYM_TAB           &bs_del       SMART_NUM      &sla RALT FUN 
     //                                           ╰─────────────┴─────────────┴─────────────╯   ╰─────────────┴─────────────┴─────────────╯
)

ZMK_LAYER(alt_layer,
     //               ╭─────────────┬─────────────┬─────────────┬─────────────┬─────────────╮   ╭─────────────┬─────────────┬─────────────┬─────────────┬─────────────╮
                        &kp Q         &kp W         &kp E         &kp R         &kp T             &kp Y         &kp U         &kp I         &kp O         &kp P
     //               ├─────────────┼─────────────┼─────────────┼─────────────┼─────────────┤   ├─────────────┼─────────────┼─────────────┼─────────────┼─────────────┤
                        &hml LCTRL A  &hml LALT S   &hml LGUI D   &hml LSHIFT F HPR_G             HPR_H         &hmr RSHIFT J &hmr RGUI K   &hmr RALT L   &hmr RCTRL FSLH 
     // ╭─────────────┼─────────────┼─────────────┼─────────────┼─────────────┼─────────────┤   ├─────────────┼─────────────┼─────────────┼─────────────┼─────────────┼─────────────╮
          &kp GRAVE     &kp Z         &kp X         &kp C         &kp V         &kp B             &kp N         &kp M         &comma_morph  &dot_morph    &excl         &kp SQT
     // ╰─────────────┴─────────────┴─────────────┼─────────────┼─────────────┼─────────────┤   ├─────────────┼─────────────┼─────────────┼─────────────┴─────────────┴─────────────╯
                                                    &kp ESC       NAV_SPACE     SYM_TAB           &bs_del       SMART_NUM      &sla RALT FUN
     //                                           ╰─────────────┴─────────────┴─────────────╯   ╰─────────────┴─────────────┴─────────────╯
)

ZMK_LAYER(nav_layer,
     //               ╭─────────────┬─────────────┬─────────────┬─────────────┬─────────────╮   ╭─────────────┬─────────────┬─────────────┬─────────────┬─────────────╮
                        &none         &none         &none         &none         &none             &none         &none         &none         &none         &none
     //               ├─────────────┼─────────────┼─────────────┼─────────────┼─────────────┤   ├─────────────┼─────────────┼─────────────┼─────────────┼─────────────┤
                        &kp LCTRL     &kp LALT      &kp LGUI      &kp LSHIFT    LHPR              &none         &tdl          &kp DOWN      &kp UP        &tdr
     // ╭─────────────┼─────────────┼─────────────┼─────────────┼─────────────┼─────────────┤   ├─────────────┼─────────────┼─────────────┼─────────────┼─────────────┼─────────────╮
          &none         &none         &none         &none         &none         &none             &none         &kp HOME      &kp PG_DN     &kp PG_UP     &kp END       &none
     // ╰─────────────┴─────────────┴─────────────┼─────────────┼─────────────┼─────────────┤   ├─────────────┼─────────────┼─────────────┼─────────────┴─────────────┴─────────────╯
                                                    &none         &none         &none             &none         &none         &none
     //                                           ╰─────────────┴─────────────┴─────────────╯   ╰─────────────┴─────────────┴─────────────╯
)

ZMK_LAYER(num_layer,
     //               ╭─────────────┬─────────────┬─────────────┬─────────────┬─────────────╮   ╭─────────────┬─────────────┬─────────────┬─────────────┬─────────────╮
                        &none         &kp N7        &kp N8        &kp N9        &none             &none         &none         &none         &none         &none
     //               ├─────────────┼─────────────┼─────────────┼─────────────┼─────────────┤   ├─────────────┼─────────────┼─────────────┼─────────────┼─────────────┤
                        &none         &kp N4        &kp N5        &kp N6        &none             RHPR          &kp RSHIFT    &kp RGUI      &kp RALT      &kp RCTRL
     // ╭─────────────┼─────────────┼─────────────┼─────────────┼─────────────┼─────────────┤   ├─────────────┼─────────────┼─────────────┼─────────────┼─────────────┼─────────────╮
          &none         &none         &kp N1        &kp N2        &kp N3        &none             &none         &none         &none         &none         &none         &none
     // ╰─────────────┴─────────────┴─────────────┴─────────────┼─────────────┼─────────────┤   ├─────────────┼─────────────┼─────────────┼─────────────┴─────────────┴─────────────╯
                                                    &kp N0        &none         &none             &bs_del         &none         &none
     //                                           ╰─────────────┴─────────────┴─────────────╯   ╰─────────────┴─────────────┴─────────────╯
)

ZMK_LAYER(sym_layer,
     //               ╭─────────────┬─────────────┬─────────────┬─────────────┬─────────────╮   ╭─────────────┬─────────────┬─────────────┬─────────────┬─────────────╮
                        &none         &none         &none         &none         &none             &kp BSLH      &kp AMPS      &kp ASTRK     &parenthesis  &kp MINUS
     //               ├─────────────┼─────────────┼─────────────┼─────────────┼─────────────┤   ├─────────────┼─────────────┼─────────────┼─────────────┼─────────────┤
                        &kp LEFT_ALT  &kp LEFT_ALT  &kp LGUI      &kp LSHIFT    LHPR              &braces       &kp DLLR      &kp PRCNT     &kp CARET     &kp PLUS
     // ╭─────────────┼─────────────┼─────────────┼─────────────┼─────────────┼─────────────┤   ├─────────────┼─────────────┼─────────────┼─────────────┼─────────────┼─────────────╮
          &none         &none         &none         &none         &none         &none             &brackets     &kp EXCL      &kp AT        &kp POUND     &thans        &kp EQUAL
     // ╰─────────────┴─────────────┴─────────────┼─────────────┼─────────────┼─────────────┤   ├─────────────┼─────────────┼─────────────┼─────────────┴─────────────┴─────────────╯
                                                    &none         &none         &none             &none         &none         &none
     //                                           ╰─────────────┴─────────────┴─────────────╯   ╰─────────────┴─────────────┴─────────────╯
)

ZMK_LAYER(fun_layer,
     //               ╭─────────────┬─────────────┬─────────────┬─────────────┬─────────────╮   ╭─────────────┬─────────────┬─────────────┬─────────────┬─────────────╮
                        &kp F12       &kp F7        &kp F8        &kp F9        &none             &none         &none         &none         &none         &none
     //               ├─────────────┼─────────────┼─────────────┼─────────────┼─────────────┤   ├─────────────┼─────────────┼─────────────┼─────────────┼─────────────┤
                        &kp F11       &kp F4        &kp F5        &kp F6        &none             RHPR          &kp RSHIFT    &kp RGUI      &kp RALT      &kp RCTRL
     // ╭─────────────┼─────────────┼─────────────┼─────────────┼─────────────┼─────────────┤   ├─────────────┼─────────────┼─────────────┼─────────────┼─────────────┼─────────────╮
          &none         &kp F10       &kp F1        &kp F2        &kp F3        &none             &none         &none         &none         &none         &none         &none
     // ╰─────────────┴─────────────┴─────────────┼─────────────┼─────────────┼─────────────┤   ├─────────────┼─────────────┼─────────────┼─────────────┴─────────────┴─────────────╯
                                                    &kp N0        &none         &none             &none         &none         &none
     //                                           ╰─────────────┴─────────────┴─────────────╯   ╰─────────────┴─────────────┴─────────────╯
)